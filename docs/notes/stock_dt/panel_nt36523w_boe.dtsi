            qcom,mdss_dsi_nt36523w_boe_2k_video {
                qcom,mdss-dsi-panel-name = "Novatek36523W video mode dsi boe panel";
                qcom,mdss-dsi-panel-type = "dsi_video_mode";
                qcom,dsi-ctrl-num = <0x0>;
                qcom,dsi-phy-num = <0x0>;
                qcom,mdss-dsi-virtual-channel-id = <0x0>;
                qcom,mdss-dsi-stream = <0x0>;
                qcom,mdss-dsi-h-left-border = <0x0>;
                qcom,mdss-dsi-h-right-border = <0x0>;
                qcom,mdss-dsi-v-top-border = <0x0>;
                qcom,mdss-dsi-v-bottom-border = <0x0>;
                qcom,mdss-dsi-bpp = <0x18>;
                qcom,mdss-dsi-color-order = "rgb_swap_rgb";
                qcom,mdss-dsi-underflow-color = <0xFF>;
                qcom,mdss-dsi-border-color = <0x0>;
                qcom,mdss-dsi-h-sync-pulse = <0x0>;
                qcom,mdss-dsi-traffic-mode = "burst_mode";
                qcom,mdss-dsi-lane-map = "lane_map_0123";
                qcom,mdss-dsi-bllp-eof-power-mode;
                qcom,mdss-dsi-bllp-power-mode;
                qcom,mdss-dsi-tx-eot-append;
                qcom,mdss-dsi-lane-0-state;
                qcom,mdss-dsi-lane-1-state;
                qcom,mdss-dsi-lane-2-state;
                qcom,mdss-dsi-lane-3-state;
                qcom,mdss-dsi-dma-trigger = "trigger_sw";
                qcom,mdss-dsi-mdp-trigger = "none";
                qcom,mdss-dsi-lp11-init;
                qcom,mdss-dsi-bl-pmic-control-type = "bl_ctrl_dcs";
                qcom,bl-update-flag = "delay_until_first_frame";
                qcom,mdss-dsi-bl-min-level = <0x1>;
                qcom,mdss-dsi-bl-max-level = <0xFFF>;
                qcom,mdss-dsi-reset-sequence = <0x1 0xA 0x0 0x5 0x1 0x2>;
                qcom,mdss-pan-physical-width-dimension = <0x8F>;
                qcom,mdss-pan-physical-height-dimension = <0xEB>;
                qcom,mdss-dsi-panel-orientation = "180";
                qcom,esd-check-enabled;
                qcom,mdss-dsi-panel-status-command = <0x6010001 0x500010A>;
                qcom,mdss-dsi-panel-status-command-mode = "dsi_lp_mode";
                qcom,mdss-dsi-panel-status-check-mode = "reg_read";
                qcom,mdss-dsi-panel-status-read-length = <0x1 0x1 0x1>;
                qcom,mdss-dsi-panel-status-valid-params = <0x1 0x1 0x1>;
                qcom,mdss-dsi-panel-status-value = <0x9C>;
                qcom,mdss-dsi-panel-max-error-count = <0x3>;
                qcom,mdss-dsi-t-clk-post = <0xE>;
                qcom,mdss-dsi-t-clk-pre = <0x35>;
                qcom,dsi-select-clocks = "mux_byte_clk0", "mux_pixel_clk0", "src_byte_clk0", "src_pixel_clk0", "shadow_byte_clk0", "shadow_pixel_clk0";
                qcom,platform-reset-gpio-always-on;
                qcom,platform-reset-gpio = <0x25 0x52 0x0>;
                phandle = <0x40B>;
                qcom,mdss-dsi-display-timings {
                    timing@0 {
                        qcom,mdss-dsi-panel-width = <0x4B0>;
                        qcom,mdss-dsi-panel-height = <0x7D0>;
                        qcom,mdss-dsi-h-front-porch = <0x3A>;
                        qcom,mdss-dsi-h-back-porch = <0x3C>;
                        qcom,mdss-dsi-h-pulse-width = <0x2>;
                        qcom,mdss-dsi-h-sync-skew = <0x0>;
                        qcom,mdss-dsi-v-back-porch = <0x5D>;
                        qcom,mdss-dsi-v-front-porch = <0x1A>;
                        qcom,mdss-dsi-v-pulse-width = <0x2>;
                        qcom,mdss-dsi-panel-framerate = <0x3C>;
                        qcom,mdss-dsi-on-command = <0x15010000 0x2FF 0x20150100 0x2 0xFB011501 0x0 0x205D915 0x1000000 0x20778 0x15010000 0x208 0x5A150100 0x2 0xD631501 0x0 0x20E9115 0x1000000 0x20F73 0x15010000 0x295 0xEB150100 0x2 0x96EB1501 0x0 0x2301115 0x1000000 0x26D66 0x15010000 0x275 0xA2150100 0x2 0x77B33901 0x0 0x11B00008 0x23004D 0x6D0089 0xA100B6 0xC93901 0x0 0x11B100DA 0x113013C 0x17E01AB 0x1F7022F 0x2313901 0x0 0x11B20267 0x2A602D1 0x308032E 0x35B036B 0x37B3901 0x0 0xDB3038E 0x3A203B7 0x3E703FD 0x3FF3901 0x0 0x11B40008 0x23004D 0x6D0089 0xA100B6 0xC93901 0x0 0x11B500DA 0x113013C 0x17E01AB 0x1F7022F 0x2313901 0x0 0x11B60267 0x2A602D1 0x308032E 0x35B036B 0x37B3901 0x0 0xDB7038E 0x3A203B7 0x3E703FD 0x3FF3901 0x0 0x11B80008 0x23004D 0x6D0089 0xA100B6 0xC93901 0x0 0x11B900DA 0x113013C 0x17E01AB 0x1F7022F 0x2313901 0x0 0x11BA0267 0x2A602D1 0x308032E 0x35B036B 0x37B3901 0x0 0xDBB038E 0x3A203B7 0x3E703FD 0x3FF1501 0x0 0x2FF2115 0x1000000 0x2FB01 0x39010000 0x11B0 0x1B 0x450065 0x810099 0xAE00C1 0x39010000 0x11B1 0xD2010B 0x1340176 0x1A301EF 0x2270229 0x39010000 0x11B2 0x25F029E 0x2C90300 0x3260353 0x3630373 0x39010000 0xDB3 0x386039A 0x3AF03DF 0x3F503F7 0x39010000 0x11B4 0x1B 0x450065 0x810099 0xAE00C1 0x39010000 0x11B5 0xD2010B 0x1340176 0x1A301EF 0x2270229 0x39010000 0x11B6 0x25F029E 0x2C90300 0x3260353 0x3630373 0x39010000 0xDB7 0x386039A 0x3AF03DF 0x3F503F7 0x39010000 0x11B8 0x1B 0x450065 0x810099 0xAE00C1 0x39010000 0x11B9 0xD2010B 0x1340176 0x1A301EF 0x2270229 0x39010000 0x11BA 0x25F029E 0x2C90300 0x3260353 0x3630373 0x39010000 0xDBB 0x386039A 0x3AF03DF 0x3F503F7 0x15010000 0x2FF 0x23150100 0x2 0xFB011501 0x0 0x2008015 0x1000000 0x20700 0x15010000 0x211 0x1150100 0x2 0x12771501 0x0 0x2150715 0x1000000 0x21607 0x15010000 0x2FF 0x24150100 0x2 0xFB011501 0x0 0x2000015 0x1000000 0x20100 0x15010000 0x202 0x1C150100 0x2 0x31C1501 0x0 0x2041D15 0x1000000 0x2051D 0x15010000 0x206 0x4150100 0x2 0x7041501 0x0 0x2080F15 0x1000000 0x2090F 0x15010000 0x20A 0xE150100 0x2 0xB0E1501 0x0 0x20C0D15 0x1000000 0x20D0D 0x15010000 0x20E 0xC150100 0x2 0xF0C1501 0x0 0x2100815 0x1000000 0x21108 0x15010000 0x212 0x150100 0x2 0x13001501 0x0 0x2140015 0x1000000 0x21500 0x15010000 0x216 0x150100 0x2 0x17001501 0x0 0x2181C15 0x1000000 0x2191C 0x15010000 0x21A 0x1D150100 0x2 0x1B1D1501 0x0 0x21C0415 0x1000000 0x21D04 0x15010000 0x21E 0xF150100 0x2 0x1F0F1501 0x0 0x2200E15 0x1000000 0x2210E 0x15010000 0x222 0xD150100 0x2 0x230D1501 0x0 0x2240C15 0x1000000 0x2250C 0x15010000 0x226 0x8150100 0x2 0x27081501 0x0 0x2280015 0x1000000 0x22900 0x15010000 0x22A 0x150100 0x2 0x2B001501 0x0 0x22D2015 0x1000000 0x22F0A 0x15010000 0x230 0x44150100 0x2 0x330C1501 0x0 0x2343215 0x1000000 0x23744 0x15010000 0x238 0x40150100 0x2 0x39001501 0x0 0x23A9A15 0x1000000 0x23BA0 0x15010000 0x23D 0x42150100 0x2 0x3F061501 0x0 0x2430615 0x1000000 0x24766 0x15010000 0x24A 0x9A150100 0x2 0x4BA01501 0x0 0x24C9115 0x1000000 0x24D21 0x15010000 0x24E 0x43150100 0x2 0x51121501 0x0 0x2523439 0x1000000 0x35582 0x2150100 0x2 0x56041501 0x0 0x2582115 0x1000000 0x25930 0x15010000 0x25A 0xBA150100 0x2 0x5BA03901 0x0 0x35E0006 0x15010000 0x25F 0x150100 0x2 0x65821501 0x0 0x27E2015 0x1000000 0x27F3C 0x15010000 0x282 0x4150100 0x2 0x97C03901 0x0 0xDB60500 0x5000000 0x505 0x1501 0x0 0x292C415 0x1000000 0x2931A 0x15010000 0x294 0x5F150100 0x2 0xD7551501 0x0 0x2DA0A15 0x1000000 0x2DE08 0x15010000 0x2DB 0x5150100 0x2 0xDCC41501 0x0 0x2DD2215 0x1000000 0x2DF05 0x15010000 0x2E0 0xC4150100 0x2 0xE1051501 0x0 0x2E2C415 0x1000000 0x2E305 0x15010000 0x2E4 0xC4150100 0x2 0xE5051501 0x0 0x2E6C415 0x1000000 0x25C88 0x15010000 0x25D 0x8150100 0x2 0x8D881501 0x0 0x28E0815 0x1000000 0x2B590 0x15010000 0x2FF 0x25150100 0x2 0xFB011501 0x0 0x2050015 0x1000000 0x21907 0x15010000 0x21F 0xBA150100 0x2 0x20A01501 0x0 0x226BA15 0x1000000 0x227A0 0x15010000 0x233 0xBA150100 0x2 0x34A01501 0x0 0x23FE015 0x1000000 0x24000 0x15010000 0x244 0x150100 0x2 0x45401501 0x0 0x248BA15 0x1000000 0x249A0 0x15010000 0x25B 0x150100 0x2 0x5C001501 0x0 0x25D0015 0x1000000 0x25ED0 0x15010000 0x261 0xBA150100 0x2 0x62A01501 0x0 0x2F11015 0x1000000 0x2FF2A 0x15010000 0x2FB 0x1150100 0x2 0x64161501 0x0 0x2671615 0x1000000 0x26A16 0x15010000 0x270 0x30150100 0x2 0xA2F31501 0x0 0x2A3FF15 0x1000000 0x2A4FF 0x15010000 0x2A5 0xFF150100 0x2 0xD6081501 0x0 0x2FF2615 0x1000000 0x2FB01 0x15010000 0x200 0xA1150100 0x2 0xAF21501 0x0 0x2042815 0x1000000 0x20630 0x15010000 0x20C 0x13150100 0x2 0xD0A1501 0x0 0x20F0A15 0x1000000 0x21100 0x15010000 0x212 0x50150100 0x2 0x13511501 0x0 0x2146515 0x1000000 0x21500 0x15010000 0x216 0x10150100 0x2 0x17A01501 0x0 0x2188615 0x1000000 0x21911 0x15010000 0x21A 0x7B150100 0x2 0x1B101501 0x0 0x21CBB15 0x1000000 0x22200 0x15010000 0x223 0x150100 0x2 0x2A111501 0x0 0x22B7B15 0x1000000 0x21D00 0x15010000 0x21E 0xC3150100 0x2 0x1FC31501 0x0 0x2240015 0x1000000 0x225C3 0x15010000 0x22F 0x5150100 0x2 0x30C31501 0x0 0x2310015 0x1000000 0x232C3 0x15010000 0x239 0x150100 0x2 0x3AC31501 0x0 0x2200115 0x1000000 0x23311 0x15010000 0x234 0x78150100 0x2 0x35161501 0x0 0x2C80415 0x1000000 0x2C982 0x15010000 0x2CA 0x4E150100 0x2 0xCB001501 0x0 0x2A94C15 0x1000000 0x2AA47 0x15010000 0x2FF 0x27150100 0x2 0xFB011501 0x0 0x2560615 0x1000000 0x25880 0x15010000 0x259 0x53150100 0x2 0x5A001501 0x0 0x25B1415 0x1000000 0x25C00 0x15010000 0x25D 0x1150100 0x2 0x5E201501 0x0 0x25F1015 0x1000000 0x26000 0x15010000 0x261 0x1D150100 0x2 0x62001501 0x0 0x2630115 0x1000000 0x26424 0x15010000 0x265 0x1C150100 0x2 0x66001501 0x0 0x2670115 0x1000000 0x26825 0x15010000 0x200 0x150100 0x2 0x78001501 0x0 0x2C30015 0x1000000 0x2D124 0x15010000 0x2D2 0x30150100 0x2 0xFF2A1501 0x0 0x2FB0115 0x1000000 0x2222F 0x15010000 0x223 0x8150100 0x2 0x24001501 0x0 0x225C315 0x1000000 0x226F8 0x15010000 0x227 0x150100 0x2 0x281A1501 0x0 0x2290015 0x1000000 0x22A1A 0x15010000 0x22B 0x150100 0x2 0x2D1A1501 0x0 0x2FFE015 0x1000000 0x2FB01 0x15010000 0x214 0x60150100 0x2 0x16C01501 0x0 0x2FFF015 0x1000000 0x2FB01 0x15010000 0x23A 0x8150100 0x2 0xFF241501 0x0 0x2FB0115 0x1000000 0x23A5D 0x15010000 0x23B 0x60150100 0x2 0x4A5D1501 0x0 0x24B6015 0x1000000 0x25A70 0x15010000 0x25B 0x60150100 0x2 0x91441501 0x0 0x2927515 0x1000000 0x2DB05 0x15010000 0x2DC 0x75150100 0x2 0xDD221501 0x0 0x2DF0515 0x1000000 0x2E075 0x15010000 0x2E1 0x5150100 0x2 0xE2751501 0x0 0x2E30515 0x1000000 0x2E475 0x15010000 0x2E5 0x5150100 0x2 0xE6751501 0x0 0x25C0015 0x1000000 0x25D00 0x15010000 0x28D 0x150100 0x2 0x8E001501 0x0 0x2FF2515 0x1000000 0x2FB01 0x15010000 0x21F 0x70150100 0x2 0x20601501 0x0 0x2267015 0x1000000 0x22760 0x15010000 0x233 0x70150100 0x2 0x34601501 0x0 0x2487015 0x1000000 0x24960 0x15010000 0x25B 0x150100 0x2 0x61701501 0x0 0x2626015 0x1000000 0x2FF26 0x15010000 0x2FB 0x1150100 0x2 0x2311501 0x0 0x2190A15 0x1000000 0x21A7F 0x15010000 0x21B 0xA150100 0x2 0x1C0C1501 0x0 0x22A0A15 0x1000000 0x22B7F 0x15010000 0x21E 0x75150100 0x2 0x1F751501 0x0 0x2257515 0x1000000 0x23075 0x15010000 0x231 0x5150100 0x2 0x328D1501 0x0 0x23A7515 0x1000000 0x2FF2A 0x15010000 0x2FB 0x1150100 0x2 0x25751501 0x0 0x2FF1015 0x1000000 0x2FB01 0x15010000 0x2B9 0x1150100 0x2 0xFF201501 0x0 0x2FB0115 0x1000000 0x21840 0x15010000 0x2FF 0x10150100 0x2 0xFB011501 0x0 0x2B90215 0x1000000 0x23500 0x15010000 0x2BB 0x13390100 0x6 0x3B035F1A 0x4041501 0xA00 0x2FF1015 0x1000000 0x2FB01 0x39010000 0x351 0x1501 0x0 0x2532C15 0x1000000 0x25500 0x39010000 0x368 0x5010501 0x6400 0x2110005 0x100001E 0x22900>;
                        qcom,mdss-dsi-off-command = [05 01 00 00 00 00 02 28 00 05 01 00 00 50 00 02 10 00];
                        qcom,mdss-dsi-on-command-state = "dsi_lp_mode";
                        qcom,mdss-dsi-off-command-state = "dsi_lp_mode";
                        qcom,mdss-dsi-panel-phy-timings = <0x2520090A 0x60204A0 0x2520090A 0x60204A0 0x2520090A 0x60204A0 0x2520090A 0x60204A0 0x251F080A 0x60204A0>;
                        qcom,display-topology = <0x1 0x0 0x1>;
                        qcom,default-topology-index = <0x0>;
                    };
                };
            };
