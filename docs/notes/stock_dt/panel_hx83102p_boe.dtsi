            qcom,mdss_dsi_himax83102p_boe_2k_video {
                qcom,mdss-dsi-panel-name = "himax83102p video mode dsi boe panel";
                qcom,mdss-dsi-panel-type = "dsi_video_mode";
                qcom,dsi-ctrl-num = <0x0>;
                qcom,dsi-phy-num = <0x0>;
                qcom,mdss-dsi-virtual-channel-id = <0x0>;
                qcom,mdss-dsi-stream = <0x0>;
                qcom,mdss-dsi-h-left-border = <0x0>;
                qcom,mdss-dsi-h-right-border = <0x0>;
                qcom,mdss-dsi-v-top-border = <0x0>;
                qcom,mdss-dsi-v-bottom-border = <0x0>;
                qcom,mdss-dsi-bpp = <0x18>;
                qcom,mdss-dsi-color-order = "rgb_swap_rgb";
                qcom,mdss-dsi-underflow-color = <0xFF>;
                qcom,mdss-dsi-border-color = <0x0>;
                qcom,mdss-dsi-h-sync-pulse = <0x0>;
                qcom,mdss-dsi-traffic-mode = "burst_mode";
                qcom,mdss-dsi-lane-map = "lane_map_0123";
                qcom,mdss-dsi-bllp-eof-power-mode;
                qcom,mdss-dsi-bllp-power-mode;
                qcom,mdss-dsi-tx-eot-append;
                qcom,mdss-dsi-lane-0-state;
                qcom,mdss-dsi-lane-1-state;
                qcom,mdss-dsi-lane-2-state;
                qcom,mdss-dsi-lane-3-state;
                qcom,mdss-dsi-dma-trigger = "trigger_sw";
                qcom,mdss-dsi-mdp-trigger = "none";
                qcom,mdss-dsi-lp11-init;
                qcom,mdss-dsi-bl-pmic-control-type = "bl_ctrl_dcs";
                qcom,bl-update-flag = "delay_until_first_frame";
                qcom,mdss-dsi-bl-min-level = <0x1>;
                qcom,mdss-dsi-bl-max-level = <0xFFF>;
                qcom,mdss-dsi-reset-sequence = <0x1 0xA 0x0 0xA 0x1 0x3C>;
                qcom,mdss-pan-physical-width-dimension = <0x8F>;
                qcom,mdss-pan-physical-height-dimension = <0xEB>;
                qcom,mdss-dsi-panel-orientation = "180";
                qcom,esd-check-enabled;
                qcom,mdss-dsi-panel-status-command = <0x6010001 0x109 0x14010001 0x10A 0x14010001 0x145>;
                qcom,mdss-dsi-panel-status-command-mode = "dsi_lp_mode";
                qcom,mdss-dsi-panel-status-check-mode = "reg_read";
                qcom,mdss-dsi-panel-status-read-length = <0x4 0x1 0x1>;
                qcom,mdss-dsi-panel-status-valid-params = <0x4 0x1 0x1>;
                qcom,mdss-dsi-panel-status-value = <0x80 0x73 0x4 0x0 0x9D 0x8>;
                qcom,mdss-dsi-panel-max-error-count = <0x3>;
                qcom,mdss-dsi-t-clk-post = <0x14>;
                qcom,mdss-dsi-t-clk-pre = <0x50>;
                qcom,dsi-select-clocks = "mux_byte_clk0", "mux_pixel_clk0", "src_byte_clk0", "src_pixel_clk0", "shadow_byte_clk0", "shadow_pixel_clk0";
                qcom,platform-reset-gpio-always-on;
                qcom,platform-reset-gpio = <0x25 0x52 0x0>;
                phandle = <0x3F4>;
                qcom,mdss-dsi-display-timings {
                    timing@0 {
                        qcom,mdss-dsi-panel-width = <0x4B0>;
                        qcom,mdss-dsi-panel-height = <0x7D0>;
                        qcom,mdss-dsi-h-front-porch = <0x3C>;
                        qcom,mdss-dsi-h-back-porch = <0x31>;
                        qcom,mdss-dsi-h-pulse-width = <0x8>;
                        qcom,mdss-dsi-h-sync-skew = <0x0>;
                        qcom,mdss-dsi-v-back-porch = <0x26>;
                        qcom,mdss-dsi-v-front-porch = <0x50>;
                        qcom,mdss-dsi-v-pulse-width = <0x8>;
                        qcom,mdss-dsi-panel-framerate = <0x3C>;
                        qcom,mdss-dsi-on-command = [39 01 00 00 00 00 04 B9 83 10 2E 15 01 00 00 00 00 02 E9 CD 15 01 00 00 00 00 02 BB 01 15 01 00 00 05 00 02 E9 00 39 01 00 00 00 00 05 D1 67 0C FF 05 39 01 00 00 00 00 12 B1 10 FA AF AF 2B 2B B2 57 4D 36 36 36 36 22 21 15 00 39 01 00 00 00 00 11 B2 00 B0 47 D0 00 2C 50 2C 00 00 00 00 15 20 D7 00 39 01 00 00 00 00 11 B4 70 60 01 01 80 67 00 00 01 9B 01 58 00 FF 00 FF 39 01 00 00 00 00 04 BF FC 85 80 39 01 00 00 00 00 03 D2 2B 2B 39 01 00 00 00 00 2C D3 00 00 00 00 78 04 00 04 00 27 00 64 4F 2D 2D 00 00 32 10 27 00 27 32 10 23 00 23 32 18 03 08 03 00 00 20 30 01 55 21 2E 01 55 0F 39 01 00 00 05 00 2F E0 00 05 0E 15 1C 30 46 4D 53 4F 68 6D 73 82 80 89 92 A6 A6 52 5A 65 70 00 05 0E 15 1C 30 46 4D 53 4F 68 6D 73 82 80 89 92 A6 A6 52 5A 65 70 15 01 00 00 05 00 02 BD 01 39 01 00 00 00 00 05 B1 01 9B 01 31 39 01 00 00 00 00 0B CB F4 36 12 16 C0 28 6C 85 3F 04 39 01 00 00 00 00 0C D3 01 00 BC 00 00 11 10 00 0E 00 01 15 01 00 00 05 00 02 BD 02 39 01 00 00 00 00 07 B4 4E 00 33 11 33 88 39 01 00 00 00 00 04 BF F2 00 02 15 01 00 00 00 00 02 BD 00 39 01 00 00 00 00 0F C0 23 23 22 11 A2 17 00 80 00 00 08 00 63 63 15 01 00 00 00 00 02 C6 F9 15 01 00 00 00 00 02 C7 30 39 01 00 00 00 00 09 C8 00 04 04 00 00 85 43 FF 39 01 00 00 00 00 04 D0 07 04 05 39 01 00 00 00 00 2D D5 18 18 18 18 1A 1A 1A 1A 1B 1B 1B 1B 24 24 24 24 07 06 07 06 05 04 05 04 03 02 03 02 01 00 01 00 21 20 21 20 18 18 18 18 18 18 18 18 39 01 00 00 05 00 18 E7 12 13 02 02 49 49 0E 0E 0F 1A 1D 74 28 74 01 07 00 00 00 00 17 00 68 15 01 00 00 00 00 02 BD 01 39 01 00 00 00 00 08 E7 02 38 01 93 0D DA 0E 15 01 00 00 00 00 02 BD 02 39 01 00 00 00 00 1D E7 FF 01 FF 01 00 00 22 00 00 00 00 00 00 00 00 00 00 00 00 00 00 00 00 00 81 00 02 40 15 01 00 00 00 00 02 BD 00 39 01 00 00 00 00 09 BA 70 03 A8 83 F2 80 C0 0D 15 01 00 00 00 00 02 BD 02 39 01 00 00 00 00 0D D8 FF FF FF FF F0 00 FF FF FF FF F0 00 15 01 00 00 00 00 02 BD 03 39 01 00 00 00 00 19 D8 AA AA AA AA A0 00 AA AA AA AA A0 00 55 55 55 55 50 00 55 55 55 55 50 00 15 01 00 00 00 00 02 BD 00 39 01 00 00 00 00 03 E1 01 06 15 01 00 00 00 00 02 CC 02 15 01 00 00 00 00 02 BD 03 15 01 00 00 00 00 02 B2 80 15 01 00 00 00 00 02 BD 00 05 01 00 00 3C 00 02 11 00 39 01 00 00 00 00 11 B2 00 B0 47 D0 00 2C 50 2C 00 00 00 00 15 20 D7 00 39 01 00 00 00 00 03 51 00 00 15 01 00 00 00 00 02 53 2C 39 01 00 00 00 00 05 C9 00 0D F0 00 39 01 00 00 00 00 04 B9 00 00 00 05 01 00 00 1E 00 02 29 00];
                        qcom,mdss-dsi-off-command = [05 01 00 00 00 00 02 28 00 05 01 00 00 3C 00 02 10 00];
                        qcom,mdss-dsi-post-off-command = <0x39010000 0x4B9 0x83102E15 0x1000000 0x2B121>;
                        qcom,mdss-dsi-pre-off-command = [15 01 00 00 00 00 02 53 24];
                        qcom,mdss-dsi-on-command-state = "dsi_lp_mode";
                        qcom,mdss-dsi-off-command-state = "dsi_lp_mode";
                        qcom,mdss-dsi-post-off-command-state = "dsi_lp_mode";
                        qcom,mdss-dsi-pre-off-command-state = "dsi_lp_mode";
                        qcom,mdss-dsi-panel-phy-timings = <0x251F0A0A 0x60204A0 0x251F0A0A 0x60204A0 0x251F0A0A 0x60204A0 0x251F0A0A 0x60204A0 0x251E0A0A 0x60204A0>;
                        qcom,display-topology = <0x1 0x0 0x1>;
                        qcom,default-topology-index = <0x0>;
                    };
                };
            };
